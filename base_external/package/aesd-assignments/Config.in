## base_external/package/aesd-assignments/Config.in
```kconfig
config BR2_PACKAGE_AESD_ASSIGNMENTS
    bool "aesd-assignments"
    help
        Assignment 3 and later components including (package) writer, finder scripts, and test utilities.
```
